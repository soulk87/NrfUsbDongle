## boards/arm/nicenanov2/nicenanov2_defconfig
```kconfig
CONFIG_ARM_MPU=y
CONFIG_HW_STACK_PROTECTION=y

# enable GPIO
CONFIG_GPIO=y

# Enable uart driver
CONFIG_SERIAL=y
CONFIG_UART_ASYNC_API=y

# enable console
CONFIG_CONSOLE=y
CONFIG_UART_CONSOLE=y
CONFIG_LOG=y
CONFIG_NRFX_GPPI=y


# Setting for UF2
# https://devzone.nordicsemi.com/f/nordic-q-a/97314/uf2-image-and-bootloader
# https://devzone.nordicsemi.com/f/nordic-q-a/89216/adafruit-bootloader-nrf-connect-zephyr-application
CONFIG_BUILD_OUTPUT_UF2=y
CONFIG_ROM_START_OFFSET=0x1000

CONFIG_FLASH=y
CONFIG_MPU_ALLOW_FLASH_WRITE=y
CONFIG_FCB=y
CONFIG_FLASH_MAP=y
CONFIG_SETTINGS=y
CONFIG_SETTINGS_FCB=y

# Enable ESB
CONFIG_ESB=y
CONFIG_CLOCK_CONTROL=y
```

## boards/nicenano/Kconfig.board
```kconfig
# Copyright (c) 2025 Nordic Semiconductor ASA
# SPDX-License-Identifier: Apache-2.0

config BOARD_NICENANO
	bool "NiceNano"
	depends on SOC_NRF52840_QIAA
```
