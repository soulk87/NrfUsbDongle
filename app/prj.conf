## prj.conf
```kconfig
CONFIG_GPIO=y

# Main stack size
CONFIG_MAIN_STACK_SIZE=8192

# USB 기능
CONFIG_USB_DEVICE_STACK=y

# USB 복합 장치 설정
CONFIG_USB_COMPOSITE_DEVICE=y
# CDC ACM 설정
CONFIG_UART_LINE_CTRL=y
CONFIG_USB_CDC_ACM=y

# HID 관련 설정
CONFIG_USB_DEVICE_HID=y
CONFIG_USB_DEVICE_PRODUCT="Zephyr HID mouse sample"
CONFIG_USB_DEVICE_PID=0x5220
CONFIG_USB_DEVICE_VID=0x0483
CONFIG_USB_DEVICE_INITIALIZE_AT_BOOT=n
CONFIG_ENABLE_HID_INT_OUT_EP=y
CONFIG_USB_HID_REPORTS=1
CONFIG_HID_INTERRUPT_EP_MPS=64
CONFIG_USB_HID_DEVICE_COUNT=2

# USB 재연결 및 안정성 개선
# CONFIG_USB_DEVICE_REMOTE_WAKEUP=y
# CONFIG_USB_DEVICE_SOF=y
# CONFIG_USB_DEVICE_BOS=y
# USB 디버깅 로그
# CONFIG_USB_DEVICE_LOG_LEVEL_DBG=y
# CONFIG_USB_HID_LOG_LEVEL_DBG=y

# 로그 시스템
CONFIG_LOG=y
# CONFIG_LOG_MODE_DEFERRED=y
# CONFIG_LOG_DEFAULT_LEVEL=4

CONFIG_GPIO_AS_PINRESET=y
CONFIG_NRFX_SPIM1=y
```

## src/main.c
```c
// main.c
#include <zephyr/kernel.h>
#include <zephyr/device.h>
#include <zephyr/logging/log.h>
#include "hw.h"
#include "ap.h"

LOG_MODULE_REGISTER(main);

int main(void) {
    LOG_INF("Starting USB HID device...");
    
    // 하드웨어 초기화
    hwInit();
    apInit();
    
    // 메인 루프
    while (1) {

        
        // // USB가 구성되어 있고 일시 중단되지 않은 경우에만 동작
        // if (usb_configured && !usb_suspended) {
        //     // 주기적으로 테스트 리포트 전송 (개발용)
        //     // send_keyboard_report();
        //     send_mouse_report();
        // }
        
        k_msleep(10);
        
        // 어플리케이션 메인 처리
        apMain();
    }

    return 0;
}
```
